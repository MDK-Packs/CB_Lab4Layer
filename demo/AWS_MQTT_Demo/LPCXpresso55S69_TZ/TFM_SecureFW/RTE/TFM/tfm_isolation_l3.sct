#! armclang --target=arm-arm-none-eabi -march=armv8-m.main -E -xc
/*
 * Copyright (c) 2017-2020 Arm Limited. All rights reserved.
 *
 * Licensed under the Apache License, Version 2.0 (the "License");
 * you may not use this file except in compliance with the License.
 * You may obtain a copy of the License at
 *
 *     http://www.apache.org/licenses/LICENSE-2.0
 *
 * Unless required by applicable law or agreed to in writing, software
 * distributed under the License is distributed on an "AS IS" BASIS,
 * WITHOUT WARRANTIES OR CONDITIONS OF ANY KIND, either express or implied.
 * See the License for the specific language governing permissions and
 * limitations under the License.
 */

/*********** WARNING: This is an auto-generated file. Do not edit! ***********/

/*
 * Customized region name prefix abbreviation:
 *  LR : A Load region.
 *  ER : A typical execution region.
 *  PT : An empty execution region used as position-tag/address-alignment.
 *
 * No applying customzied prefixes on linker/system reserved/intentional
 * names, such as 'ARM_LIB_STACK'.
 */

#include "region_defs.h"

LR_CODE S_CODE_START {

    PT_RO_START S_CODE_START ALIGN 32 EMPTY 0x0 {
        /* Position tag: code + RO-data */
    }

    /**** This initial section contains mainly the SPM code and RO-data */
    ER_TFM_CODE +0 ALIGN 32 {
        *.o (RESET +First)
        * (+RO)
    }

    /**** PSA RoT CODE + RO-data starts here */
#ifdef TFM_PARTITION_INTERNAL_TRUSTED_STORAGE
    ER_TFM_SP_ITS_RO +0 ALIGN 32 {
        *tfm_partition_its.* (+RO)
        *tfm_internal_trusted_storage.* (+RO)
        *its_utils.* (+RO)
        *its_flash.* (+RO)
        *its_flash*.* (+RO)
        *(TFM_SP_ITS_ATTR_FN)
    }
#endif /* TFM_PARTITION_INTERNAL_TRUSTED_STORAGE */

#ifdef TFM_PARTITION_AUDIT_LOG
    ER_TFM_SP_AUDIT_LOG_RO +0 ALIGN 32 {
        *tfm_partition_audit.* (+RO)
        *audit_core.* (+RO)
        *(TFM_SP_AUDIT_LOG_ATTR_FN)
    }
#endif /* TFM_PARTITION_AUDIT_LOG */

#ifdef TFM_PARTITION_CRYPTO
    ER_TFM_SP_CRYPTO_RO +0 ALIGN 32 {
        *tfm_partition_crypto.* (+RO)
        *crypto_init.* (+RO)
        *crypto_alloc.* (+RO)
        *crypto_cipher.* (+RO)
        *crypto_hash.* (+RO)
        *crypto_mac.* (+RO)
        *crypto_key.* (+RO)
        *crypto_aead.* (+RO)
        *crypto_asymmetric.* (+RO)
        *crypto_key_derivation.* (+RO)
        *(TFM_SP_CRYPTO_ATTR_FN)
    }
#endif /* TFM_PARTITION_CRYPTO */

#ifdef TFM_PARTITION_PLATFORM
    ER_TFM_SP_PLATFORM_RO +0 ALIGN 32 {
        *tfm_partition_platform.* (+RO)
        *platform_sp.* (+RO)
        *(TFM_SP_PLATFORM_ATTR_FN)
    }
#endif /* TFM_PARTITION_PLATFORM */

#ifdef TFM_PARTITION_INITIAL_ATTESTATION
    ER_TFM_SP_INITIAL_ATTESTATION_RO +0 ALIGN 32 {
        *tfm_partition_attestation.* (+RO)
        *tfm_attest.* (+RO)
        *tfm_attest_req_mngr.* (+RO)
        *attest_core.* (+RO)
        *attest_token_encode.* (+RO)
        *attest_asymmetric_key.* (+RO)
        *attest_symmetric_key.* (+RO)
        *(TFM_SP_INITIAL_ATTESTATION_ATTR_FN)
    }
#endif /* TFM_PARTITION_INITIAL_ATTESTATION */

#ifdef TFM_PARTITION_TEST_CORE
    ER_TFM_SP_CORE_TEST_RO +0 ALIGN 32 {
        *tfm_ss_core_test.* (+RO)
        *(TFM_SP_CORE_TEST_ATTR_FN)
    }
#endif /* TFM_PARTITION_TEST_CORE */

#ifdef TFM_PARTITION_TEST_SECURE_SERVICES
    ER_TFM_SP_SECURE_TEST_PARTITION_RO +0 ALIGN 32 {
        *tfm_secure_client_service.* (+RO)
        *test_framework* (+RO)
        *uart_stdout.* (+RO)
        *Driver_USART.* (+RO)
        *arm_uart_drv.* (+RO)
        *uart_pl011_drv.* (+RO)
        *uart_cmsdk_drv* (+RO)
        *secure_suites.* (+RO)
        *attestation_s_interface_testsuite.* (+RO)
        *(TFM_SP_SECURE_TEST_PARTITION_ATTR_FN)
    }
#endif /* TFM_PARTITION_TEST_SECURE_SERVICES */

#ifdef TFM_PARTITION_TEST_CORE_IPC
    ER_TFM_SP_IPC_SERVICE_TEST_RO +0 ALIGN 32 {
        *tfm_ipc_service_test.* (+RO)
        *(TFM_SP_IPC_SERVICE_TEST_ATTR_FN)
    }
#endif /* TFM_PARTITION_TEST_CORE_IPC */

#ifdef TFM_PARTITION_TEST_PS
    ER_TFM_SP_PS_TEST_RO +0 ALIGN 32 {
        *tfm_ps_test_service.* (+RO)
        *(TFM_SP_PS_TEST_ATTR_FN)
    }
#endif /* TFM_PARTITION_TEST_PS */

    /**** PSA RoT CODE + RO-data ends here */

    /**** APPLICATION RoT CODE + RO-data starts here */
#ifdef TFM_PARTITION_PROTECTED_STORAGE
    ER_TFM_SP_PS_RO +0 ALIGN 32 {
        *tfm_partition_ps.* (+RO)
        *tfm_protected_storage.* (+RO)
        *tfm_ps_req_mngr.* (+RO)
        *ps_object_system.* (+RO)
        *ps_object_table.* (+RO)
        *ps_utils.* (+RO)
        *ps_crypto_interface.* (+RO)
        *ps_encrypted_object.* (+RO)
        *ps_nv_counters.* (+RO)
        *test_ps_nv_counters.* (+RO)
        *(TFM_SP_PS_ATTR_FN)
    }
#endif /* TFM_PARTITION_PROTECTED_STORAGE */

#ifdef TFM_PARTITION_TEST_CORE
    ER_TFM_SP_CORE_TEST_2_RO +0 ALIGN 32 {
        *tfm_ss_core_test_2.* (+RO)
        *(TFM_SP_CORE_TEST_2_ATTR_FN)
    }
#endif /* TFM_PARTITION_TEST_CORE */

#ifdef TFM_PARTITION_TEST_CORE_IPC
    ER_TFM_SP_IPC_CLIENT_TEST_RO +0 ALIGN 32 {
        *tfm_ipc_client_test.* (+RO)
        *(TFM_SP_IPC_CLIENT_TEST_ATTR_FN)
    }
#endif /* TFM_PARTITION_TEST_CORE_IPC */

#ifdef TFM_ENABLE_IRQ_TEST
    ER_TFM_IRQ_TEST_1_RO +0 ALIGN 32 {
        *tfm_irq_test_service_1.* (+RO)
        *timer_cmsdk* (+RO)
*(:gdef:tfm_enable_irq)
*(:gdef:tfm_disable_irq)
        *(TFM_IRQ_TEST_1_ATTR_FN)
    }
#endif /* TFM_ENABLE_IRQ_TEST */

#ifdef TFM_PARTITION_TEST_SECURE_SERVICES
    ER_TFM_SP_SECURE_CLIENT_2_RO +0 ALIGN 32 {
        *tfm_secure_client_2.* (+RO)
        *(TFM_SP_SECURE_CLIENT_2_ATTR_FN)
    }
#endif /* TFM_PARTITION_TEST_SECURE_SERVICES */

    /**** APPLICATION RoT CODE + RO-data ends here */

    /**** Unprivileged Secure code + RO-data starts here */
    TFM_UNPRIV_CODE +0 ALIGN 32 {
        platform_retarget_dev.o (+RO)
        device_definition.o (+RO)
        *(SFN)
        *armlib* (+RO)
        *libtfm_sprt.a (+RO)
        *psa_client.* (+RO)
        *psa_service.* (+RO)
        *psa_lifecycle.* (+RO)
    }

    PT_RO_END +0 ALIGN 32 EMPTY 0x0 {
        /* Position tag */
    }

    /**** Base address of secure data area */
    PT_SECURE_DATA_START S_DATA_START EMPTY 0x0 {
        /* Position tag */
    }

    PT_PRIV_RWZI_START +0 ALIGN 32 EMPTY 0x0 {
        /* Position tag */
    }

    /* Shared area between BL2 and runtime to exchange data */
    TFM_SHARED_DATA +0 ALIGN 32 OVERLAY EMPTY BOOT_TFM_SHARED_DATA_SIZE {
    }

    /* MSP */
    ARM_LIB_STACK_MSP +0 ALIGN 32 OVERLAY EMPTY S_MSP_STACK_SIZE {
    }

    ARM_LIB_HEAP +0 ALIGN 8 EMPTY S_HEAP_SIZE {
    }

    ER_TFM_DATA +0 {
        * (+RW +ZI)
    }

    /**** PSA RoT RWZI starts here */
#ifdef TFM_PARTITION_INTERNAL_TRUSTED_STORAGE

    PT_TFM_SP_ITS_PRIVATE_DATA_START +0 ALIGN 32 {
        /* Position tag */
    }

    ER_TFM_SP_ITS_RWZI +0 ALIGN 32 {
        *tfm_partition_its.* (+RW +ZI)
        *tfm_internal_trusted_storage.* (+RW +ZI)
        *its_utils.* (+RW +ZI)
        *its_flash.* (+RW +ZI)
        *its_flash*.* (+RW +ZI)
        *(TFM_SP_ITS_ATTR_RW)
        *(TFM_SP_ITS_ATTR_ZI)
    }

    TFM_SP_ITS_LINKER_STACK +0 ALIGN 128 EMPTY 0x680 {
    }

    PT_TFM_SP_ITS_PRIVATE_DATA_END +0 ALIGN 32 {
        /* Position tag */
    }

#endif /* TFM_PARTITION_INTERNAL_TRUSTED_STORAGE */

#ifdef TFM_PARTITION_AUDIT_LOG

    PT_TFM_SP_AUDIT_LOG_PRIVATE_DATA_START +0 ALIGN 32 {
        /* Position tag */
    }

    ER_TFM_SP_AUDIT_LOG_RWZI +0 ALIGN 32 {
        *tfm_partition_audit.* (+RW +ZI)
        *audit_core.* (+RW +ZI)
        *(TFM_SP_AUDIT_LOG_ATTR_RW)
        *(TFM_SP_AUDIT_LOG_ATTR_ZI)
    }

    TFM_SP_AUDIT_LOG_LINKER_STACK +0 ALIGN 128 EMPTY 0 {
    }

    PT_TFM_SP_AUDIT_LOG_PRIVATE_DATA_END +0 ALIGN 32 {
        /* Position tag */
    }

#endif /* TFM_PARTITION_AUDIT_LOG */

#ifdef TFM_PARTITION_CRYPTO

    PT_TFM_SP_CRYPTO_PRIVATE_DATA_START +0 ALIGN 32 {
        /* Position tag */
    }

    ER_TFM_SP_CRYPTO_RWZI +0 ALIGN 32 {
        *tfm_partition_crypto.* (+RW +ZI)
        *crypto_init.* (+RW +ZI)
        *crypto_alloc.* (+RW +ZI)
        *crypto_cipher.* (+RW +ZI)
        *crypto_hash.* (+RW +ZI)
        *crypto_mac.* (+RW +ZI)
        *crypto_key.* (+RW +ZI)
        *crypto_aead.* (+RW +ZI)
        *crypto_asymmetric.* (+RW +ZI)
        *crypto_key_derivation.* (+RW +ZI)
        *(TFM_SP_CRYPTO_ATTR_RW)
        *(TFM_SP_CRYPTO_ATTR_ZI)
    }

    TFM_SP_CRYPTO_LINKER_STACK +0 ALIGN 128 EMPTY 0x2000 {
    }

    PT_TFM_SP_CRYPTO_PRIVATE_DATA_END +0 ALIGN 32 {
        /* Position tag */
    }

#endif /* TFM_PARTITION_CRYPTO */

#ifdef TFM_PARTITION_PLATFORM

    PT_TFM_SP_PLATFORM_PRIVATE_DATA_START +0 ALIGN 32 {
        /* Position tag */
    }

    ER_TFM_SP_PLATFORM_RWZI +0 ALIGN 32 {
        *tfm_partition_platform.* (+RW +ZI)
        *platform_sp.* (+RW +ZI)
        *(TFM_SP_PLATFORM_ATTR_RW)
        *(TFM_SP_PLATFORM_ATTR_ZI)
    }

    TFM_SP_PLATFORM_LINKER_STACK +0 ALIGN 128 EMPTY 0x0500 {
    }

    PT_TFM_SP_PLATFORM_PRIVATE_DATA_END +0 ALIGN 32 {
        /* Position tag */
    }

#endif /* TFM_PARTITION_PLATFORM */

#ifdef TFM_PARTITION_INITIAL_ATTESTATION

    PT_TFM_SP_INITIAL_ATTESTATION_PRIVATE_DATA_START +0 ALIGN 32 {
        /* Position tag */
    }

    ER_TFM_SP_INITIAL_ATTESTATION_RWZI +0 ALIGN 32 {
        *tfm_partition_attestation.* (+RW +ZI)
        *tfm_attest.* (+RW +ZI)
        *tfm_attest_req_mngr.* (+RW +ZI)
        *attest_core.* (+RW +ZI)
        *attest_token_encode.* (+RW +ZI)
        *attest_asymmetric_key.* (+RW +ZI)
        *attest_symmetric_key.* (+RW +ZI)
        *(TFM_SP_INITIAL_ATTESTATION_ATTR_RW)
        *(TFM_SP_INITIAL_ATTESTATION_ATTR_ZI)
    }

    TFM_SP_INITIAL_ATTESTATION_LINKER_STACK +0 ALIGN 128 EMPTY 0x0A80 {
    }

    PT_TFM_SP_INITIAL_ATTESTATION_PRIVATE_DATA_END +0 ALIGN 32 {
        /* Position tag */
    }

#endif /* TFM_PARTITION_INITIAL_ATTESTATION */

#ifdef TFM_PARTITION_TEST_CORE

    PT_TFM_SP_CORE_TEST_PRIVATE_DATA_START +0 ALIGN 32 {
        /* Position tag */
    }

    ER_TFM_SP_CORE_TEST_RWZI +0 ALIGN 32 {
        *tfm_ss_core_test.* (+RW +ZI)
        *(TFM_SP_CORE_TEST_ATTR_RW)
        *(TFM_SP_CORE_TEST_ATTR_ZI)
    }

    TFM_SP_CORE_TEST_LINKER_STACK +0 ALIGN 128 EMPTY 0x0380 {
    }

    PT_TFM_SP_CORE_TEST_PRIVATE_DATA_END +0 ALIGN 32 {
        /* Position tag */
    }

#endif /* TFM_PARTITION_TEST_CORE */

#ifdef TFM_PARTITION_TEST_SECURE_SERVICES

    PT_TFM_SP_SECURE_TEST_PARTITION_PRIVATE_DATA_START +0 ALIGN 32 {
        /* Position tag */
    }

    ER_TFM_SP_SECURE_TEST_PARTITION_RWZI +0 ALIGN 32 {
        *tfm_secure_client_service.* (+RW +ZI)
        *test_framework* (+RW +ZI)
        *uart_stdout.* (+RW +ZI)
        *Driver_USART.* (+RW +ZI)
        *arm_uart_drv.* (+RW +ZI)
        *uart_pl011_drv.* (+RW +ZI)
        *uart_cmsdk_drv* (+RW +ZI)
        *secure_suites.* (+RW +ZI)
        *attestation_s_interface_testsuite.* (+RW +ZI)
        *(TFM_SP_SECURE_TEST_PARTITION_ATTR_RW)
        *(TFM_SP_SECURE_TEST_PARTITION_ATTR_ZI)
    }

    TFM_SP_SECURE_TEST_PARTITION_LINKER_STACK +0 ALIGN 128 EMPTY 0x0D00 {
    }

    PT_TFM_SP_SECURE_TEST_PARTITION_PRIVATE_DATA_END +0 ALIGN 32 {
        /* Position tag */
    }

#endif /* TFM_PARTITION_TEST_SECURE_SERVICES */

#ifdef TFM_PARTITION_TEST_CORE_IPC

    PT_TFM_SP_IPC_SERVICE_TEST_PRIVATE_DATA_START +0 ALIGN 32 {
        /* Position tag */
    }

    ER_TFM_SP_IPC_SERVICE_TEST_RWZI +0 ALIGN 32 {
        *tfm_ipc_service_test.* (+RW +ZI)
        *(TFM_SP_IPC_SERVICE_TEST_ATTR_RW)
        *(TFM_SP_IPC_SERVICE_TEST_ATTR_ZI)
    }

    TFM_SP_IPC_SERVICE_TEST_LINKER_STACK +0 ALIGN 128 EMPTY 0x0220 {
    }

    PT_TFM_SP_IPC_SERVICE_TEST_PRIVATE_DATA_END +0 ALIGN 32 {
        /* Position tag */
    }

#endif /* TFM_PARTITION_TEST_CORE_IPC */

#ifdef TFM_PARTITION_TEST_PS

    PT_TFM_SP_PS_TEST_PRIVATE_DATA_START +0 ALIGN 32 {
        /* Position tag */
    }

    ER_TFM_SP_PS_TEST_RWZI +0 ALIGN 32 {
        *tfm_ps_test_service.* (+RW +ZI)
        *(TFM_SP_PS_TEST_ATTR_RW)
        *(TFM_SP_PS_TEST_ATTR_ZI)
    }

    TFM_SP_PS_TEST_LINKER_STACK +0 ALIGN 128 EMPTY 0x500 {
    }

    PT_TFM_SP_PS_TEST_PRIVATE_DATA_END +0 ALIGN 32 {
        /* Position tag */
    }

#endif /* TFM_PARTITION_TEST_PS */


    /**** PSA RoT RWZI ends here */
    PT_PRIV_RWZI_END +0 ALIGN 32 EMPTY 0x0 {
        /* Position tag */
    }

    /* PSP is unprivileged in single-core topology */
    ARM_LIB_STACK +0 ALIGN 32 EMPTY S_PSP_STACK_SIZE {
    }

#ifdef TFM_PARTITION_PROTECTED_STORAGE

    PT_TFM_SP_PS_PRIVATE_DATA_START +0 ALIGN 32 {
        /* Position tag */
    }

    ER_TFM_SP_PS_RWZI +0 ALIGN 32 {
        *tfm_partition_ps.* (+RW +ZI)
        *tfm_protected_storage.* (+RW +ZI)
        *tfm_ps_req_mngr.* (+RW +ZI)
        *ps_object_system.* (+RW +ZI)
        *ps_object_table.* (+RW +ZI)
        *ps_utils.* (+RW +ZI)
        *ps_crypto_interface.* (+RW +ZI)
        *ps_encrypted_object.* (+RW +ZI)
        *ps_nv_counters.* (+RW +ZI)
        *test_ps_nv_counters.* (+RW +ZI)
        *(TFM_SP_PS_ATTR_RW)
        *(TFM_SP_PS_ATTR_ZI)
    }

    TFM_SP_PS_LINKER_STACK +0 ALIGN 128 EMPTY 0x800 {
    }

    PT_TFM_SP_PS_PRIVATE_DATA_END +0 ALIGN 32 {
        /* Position tag */
    }

#endif /* TFM_PARTITION_PROTECTED_STORAGE */

#ifdef TFM_PARTITION_TEST_CORE

    PT_TFM_SP_CORE_TEST_2_PRIVATE_DATA_START +0 ALIGN 32 {
        /* Position tag */
    }

    ER_TFM_SP_CORE_TEST_2_RWZI +0 ALIGN 32 {
        *tfm_ss_core_test_2.* (+RW +ZI)
        *(TFM_SP_CORE_TEST_2_ATTR_RW)
        *(TFM_SP_CORE_TEST_2_ATTR_ZI)
    }

    TFM_SP_CORE_TEST_2_LINKER_STACK +0 ALIGN 128 EMPTY 0x0280 {
    }

    PT_TFM_SP_CORE_TEST_2_PRIVATE_DATA_END +0 ALIGN 32 {
        /* Position tag */
    }

#endif /* TFM_PARTITION_TEST_CORE */

#ifdef TFM_PARTITION_TEST_CORE_IPC

    PT_TFM_SP_IPC_CLIENT_TEST_PRIVATE_DATA_START +0 ALIGN 32 {
        /* Position tag */
    }

    ER_TFM_SP_IPC_CLIENT_TEST_RWZI +0 ALIGN 32 {
        *tfm_ipc_client_test.* (+RW +ZI)
        *(TFM_SP_IPC_CLIENT_TEST_ATTR_RW)
        *(TFM_SP_IPC_CLIENT_TEST_ATTR_ZI)
    }

    TFM_SP_IPC_CLIENT_TEST_LINKER_STACK +0 ALIGN 128 EMPTY 0x0300 {
    }

    PT_TFM_SP_IPC_CLIENT_TEST_PRIVATE_DATA_END +0 ALIGN 32 {
        /* Position tag */
    }

#endif /* TFM_PARTITION_TEST_CORE_IPC */

#ifdef TFM_ENABLE_IRQ_TEST

    PT_TFM_IRQ_TEST_1_PRIVATE_DATA_START +0 ALIGN 32 {
        /* Position tag */
    }

    ER_TFM_IRQ_TEST_1_RWZI +0 ALIGN 32 {
        *tfm_irq_test_service_1.* (+RW +ZI)
        *timer_cmsdk* (+RW +ZI)
        *(TFM_IRQ_TEST_1_ATTR_RW)
        *(TFM_IRQ_TEST_1_ATTR_ZI)
    }

    TFM_IRQ_TEST_1_LINKER_STACK +0 ALIGN 128 EMPTY 0x0400 {
    }

    PT_TFM_IRQ_TEST_1_PRIVATE_DATA_END +0 ALIGN 32 {
        /* Position tag */
    }

#endif /* TFM_ENABLE_IRQ_TEST */

#ifdef TFM_PARTITION_TEST_SECURE_SERVICES

    PT_TFM_SP_SECURE_CLIENT_2_PRIVATE_DATA_START +0 ALIGN 32 {
        /* Position tag */
    }

    ER_TFM_SP_SECURE_CLIENT_2_RWZI +0 ALIGN 32 {
        *tfm_secure_client_2.* (+RW +ZI)
        *(TFM_SP_SECURE_CLIENT_2_ATTR_RW)
        *(TFM_SP_SECURE_CLIENT_2_ATTR_ZI)
    }

    TFM_SP_SECURE_CLIENT_2_LINKER_STACK +0 ALIGN 128 EMPTY 0x300 {
    }

    PT_TFM_SP_SECURE_CLIENT_2_PRIVATE_DATA_END +0 ALIGN 32 {
        /* Position tag */
    }

#endif /* TFM_PARTITION_TEST_SECURE_SERVICES */


    PT_SRAM_WATERMARK +0 EMPTY 0x0 {
        /* Position tag */
    }

    /* Make sure that the sections allocated in the SRAM does not exceed the
     * size of the SRAM available.
     */
    ScatterAssert(ImageLimit(PT_SRAM_WATERMARK) <= S_DATA_START + S_DATA_SIZE)

#if defined(S_CODE_SRAM_ALIAS_BASE)
    /* eFlash driver code that gets copied from Flash to SRAM */
    ER_EFLASH_DRIVER_RO S_CODE_SRAM_ALIAS_BASE ALIGN 32 {
        Driver_GFC100_EFlash.o (+RO)
        gfc100_eflash_drv.o (+RO)
        musca_b1_eflash_drv.o (+RO)
    }
#endif
}

LR_VENEER CMSE_VENEER_REGION_START {
    /*
     * Place the CMSE Veneers (containing the SG instruction) in a separate
     * 32 bytes aligned region so that the SAU can be programmed to
     * just set this region as Non-Secure Callable.
     */
    ER_CODE_CMSE_VENEER CMSE_VENEER_REGION_START CMSE_VENEER_REGION_SIZE {
        *(Veneer$$CMSE)
    }
}

LR_NS_PARTITION NS_PARTITION_START {
    /* Reserved place for NS application.
     * No code will be placed here, just address of this region is used in the
     * secure code to configure certain HW components. This generates an empty
     * execution region description warning during linking.
     */
    ER_NS_PARTITION NS_PARTITION_START UNINIT NS_PARTITION_SIZE {
    }
}

#ifdef BL2
LR_SECONDARY_PARTITION SECONDARY_PARTITION_START {
    /* Reserved place for new image in case of firmware upgrade.
     * No code will be placed here, just address of this region is used in the
     * secure code to configure certain HW components. This generates an empty
     * execution region description warning during linking.
     */
    ER_SECONDARY_PARTITION SECONDARY_PARTITION_START \
        UNINIT SECONDARY_PARTITION_SIZE {
    }
}
#endif /* BL2 */
